## conf/layer.conf
```bitbake
# We might have a conf and classes directory, append to BBPATH
BBPATH .= ":${LAYERDIR}"

# We have a recipes directory, add to BBFILES
BBFILES += "${LAYERDIR}/recipes*/*/*.bb ${LAYERDIR}/recipes*/*/*.bbappend"

BBFILE_COLLECTIONS += "meta-dominion"
BBFILE_PATTERN_meta-dominion := "^${LAYERDIR}/"
BBFILE_PRIORITY_meta-dominion = "8"

LAYERDEPENDS_meta-dominion = "core openembedded-layer"

LAYERSERIES_COMPAT_meta-dominion = "walnascar styhead"
```

## conf/machine/rogue.conf
```bitbake
#@TYPE: Machine
#@NAME: common_pc
#@DESCRIPTION: Machine configuration for running a common x86

PREFERRED_PROVIDER_virtual/xserver ?= "xserver-xorg"
PREFERRED_PROVIDER_virtual/libgl ?= "mesa"
PREFERRED_PROVIDER_virtual/libgles1 ?= "mesa"
PREFERRED_PROVIDER_virtual/libgles2 ?= "mesa"

require conf/machine/include/tune-corei7.inc

KERNEL_IMAGETYPE = "bzImage"

SERIAL_CONSOLE = "115200 ttyS0"

XSERVER = "xserver-xorg \
           mesa-megadriver \
           xf86-input-evdev \
           xf86-video-modesetting \
          "

MACHINE_FEATURES = "alsa bluetooth efi screen"

IMAGE_FSTYPES += "tar.xz"
IMAGE_FSTYPES_remove = "ext4"

PREFERRED_PROVIDER_virtual/kernel ?= "linux-dominion"

MACHINE_FEATURES += "x86"

MACHINE_ESSENTIAL_EXTRA_RDEPENDS += "linux-firmware"
```

## conf/machine/soekris-net6501.conf
```bitbake
#@TYPE: Machine
#@NAME: common_pc
#@DESCRIPTION: Machine configuration for running a common x86

PREFERRED_PROVIDER_virtual/xserver ?= "xserver-xorg"
PREFERRED_PROVIDER_virtual/libgl ?= "mesa-gl"
PREFERRED_PROVIDER_virtual/libgles1 ?= "mesa-gl"
PREFERRED_PROVIDER_virtual/libgles2 ?= "mesa-gl"

PNBLACKLIST[linux-yocto] = "this machine uses a different kernel recipe"

require conf/machine/include/intel-core2-32-common.inc
require conf/machine/include/intel-common-pkgarch.inc
require conf/machine/include/meta-intel.inc

MACHINE_HWCODECS ?= "va-intel"

KERNEL_IMAGETYPE = "bzImage"

SERIAL_CONSOLE = "115200 ttyS0"

XSERVER = "xserver-xorg \
           mesa-megadriver \
           xf86-input-evdev \
           xf86-video-modesetting"

MACHINE_FEATURES = "alsa bluetooth screen"

IMAGE_FSTYPES += "tar.xz"

PREFERRED_PROVIDER_virtual/kernel = "linux-dominion"

MACHINE_FEATURES += "x86"
```

## old/conf/machine/apu2c4.conf
```bitbake
#@TYPE: Machine
#@NAME: apu2c4
#@DESCRIPTION: Machine configuration for PC engines APU2c4 - http://pcengines.ch/apu2c4.htm

PREFERRED_PROVIDER_virtual/xserver ?= "xserver-xorg"
PREFERRED_PROVIDER_virtual/libgl ?= "mesa"
PREFERRED_PROVIDER_virtual/libgles1 ?= "mesa"
PREFERRED_PROVIDER_virtual/libgles2 ?= "mesa"

require conf/machine/include/tune-corei7.inc

KERNEL_IMAGETYPE = "bzImage"

SERIAL_CONSOLE = "115200 ttyS0"

GRUBPLATFORM = "pc"

# Headless, but set a sane default

XSERVER = "xserver-xorg \
           xf86-input-evdev \
           xf86-video-modesetting \
          "

MACHINE_FEATURES = "alsa bluetooth wifi"

IMAGE_FSTYPES += "tar.xz"
IMAGE_FSTYPES_remove = "ext4"

PREFERRED_PROVIDER_virtual/kernel ?= "linux-dominion"

MACHINE_FEATURES += "x86"
```

## old/conf/machine/arietta-g25.conf
```bitbake
#@TYPE: Machine
#@Name: Arietta G25 by www.acmesystems.it
#@DESCRIPTION: Machine configuration for the Arietta G25

require conf/machine/include/tune-arm926ejs.inc

MACHINE_FEATURES = "kernel26 apm alsa ext2 ext3 usbhost usbgadget can ppp"
KERNEL_DEVICETREE = "${S}/arch/arm/boot/dts/acme-arietta.dts \
                     "
PREFERRED_PROVIDER_virtual/kernel = "linux-dominion"
PREFERRED_PROVIDER_virtual/bootloader = "at91bootstrap"

AT91BOOTSTRAP_MACHINE = "acme_arietta"
AT91BOOTSTRAP_TARGET = "acme_ariettasd_linux_zimage_dt_defconfig"
AT91BOOTSTRAP_BINARY = "acme_arietta-sdcardboot-linux-zimage-dt"

# used by sysvinit_2
SERIAL_CONSOLE ?= "115200 ttyS0"

UBOOT_ENTRYPOINT = "0x20008000"
UBOOT_LOADADDRESS = "0x20008000"

# For the ACME systems wifi daughterboard
MACHINE_ESSENTIAL_EXTRA_RRECOMMENDS += "linux-firmware-ralink \
                                        kernel-module-rt2800usb \
                                        kernel-module-rt2x00usb \
                                       "
```

## old/conf/machine/dlink-dns320.conf
```bitbake
#@TYPE: Machine
#@Name: DNS-320 NAS by D-Link
#@DESCRIPTION: Machine configuration for the D-Link DNS320

require conf/machine/include/tune-arm926ejs.inc

MACHINE_FEATURES = "kernel26 ext2 ext3 usbhost"
KERNEL_DEVICETREE = "kirkwood-dns320.dtb"
PREFERRED_PROVIDER_virtual/kernel = "linux-dominion"
PREFERRED_PROVIDER_virtual/bootloader = "u-boot"

# used by sysvinit_2
SERIAL_CONSOLE ?= "115200 ttyS0"

UBOOT_ENTRYPOINT = "0x00008000"
UBOOT_LOADADDRESS = "0x00008000"

UBOOT_MACHINE = "dns320_defconfig"
UBOOT_SUFFIX = "kwb"
UBOOT_MAKE_TARGET = "u-boot.${UBOOT_SUFFIX}"

MACHINE_ESSENTIAL_EXTRA_RRECOMMENDS += " \
                                        kernel-module-ahci-mvebu \
                                        kernel-module-raid0 \
                                        kernel-module-raid1 \
                                        kernel-module-raid456 \
                                        kernel-module-raid10 \
                                       "

IMAGE_FSTYPES_append = " ubi"

UBI_VOLNAME = "rootfs"

MKUBIFS_ARGS = "--min-io-size=2048 --leb-size=129024 --max-leb-cnt=1016 --compr=favor_lzo"
UBINIZE_ARGS = "--peb-size=128KiB --min-io-size=2048 --sub-page-size=512"
```

## old/conf/machine/macbook.conf
```bitbake
#@TYPE: Machine
#@NAME: common_pc
#@DESCRIPTION: Machine configuration for running a common x86

PREFERRED_PROVIDER_virtual/xserver ?= "xserver-xorg"
PREFERRED_PROVIDER_virtual/libgl ?= "mesa"
PREFERRED_PROVIDER_virtual/libgles1 ?= "mesa"
PREFERRED_PROVIDER_virtual/libgles2 ?= "mesa"

DEFAULTTUNE ?= "core2-64"
require conf/machine/include/tune-core2.inc
require conf/machine/include/intel-common-pkgarch.inc

KERNEL_IMAGETYPE = "bzImage"

SERIAL_CONSOLE = "115200 ttyS0"

XSERVER = "xserver-xorg \
           mesa-megadriver \
           xf86-input-evdev \
           xf86-input-synaptics \
           xf86-video-modesetting \
           xf86-video-nouveau"

MACHINE_FEATURES = "alsa bluetooth wifi screen"

IMAGE_FSTYPES += "tar.xz"

PREFERRED_PROVIDER_virtual/kernel ?= "linux-dominion"

MACHINE_FEATURES += "x86"
```

## old/conf/machine/revo.conf
```bitbake
#@TYPE: Machine
#@NAME: revo

#@WEBTITLE: Acer revo

#@DESCRIPTION: Machine configuration for Acer Revo

require conf/machine/include/intel-core2-32-common.inc
require conf/machine/include/meta-intel.inc
require conf/machine/include/intel-common-pkgarch.inc

MACHINE_FEATURES += "bios alsa bluetooth wifi"

PREFERRED_PROVIDER_virtual/kernel = "linux-dominion"

XSERVER = "xserver-xorg \
           mesa-megadriver \
           xf86-input-evdev \
           xf86-input-libinput \
           xf86-video-modesetting \
           xf86-video-nouveau \
          "

# Include all firmware packages for the most compatible experience
MACHINE_EXTRA_RRECOMMENDS += "linux-firmware"
```
