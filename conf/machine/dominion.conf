## conf/machine/dominion.conf
```bitbake
#@TYPE: Machine
#@NAME: common_pc
#@DESCRIPTION: Machine configuration for running a common x86

PREFERRED_PROVIDER_virtual/xserver ?= "xserver-xorg"
PREFERRED_PROVIDER_virtual/libgl ?= "mesa"
PREFERRED_PROVIDER_virtual/libgles1 ?= "mesa"
PREFERRED_PROVIDER_virtual/libgles2 ?= "mesa"

require conf/machine/include/x86/tune-x86-64-v3.inc

KERNEL_IMAGETYPE = "bzImage"

SERIAL_CONSOLE = "115200 ttyS0"

XSERVER = "xserver-xorg \
           mesa-megadriver \
           xf86-input-evdev \
           xf86-video-modesetting \
           "

MACHINE_FEATURES = "alsa bluetooth wifi efi screen"

IMAGE_FSTYPES += "tar.gz"
IMAGE_FSTYPES:remove = "ext4"

PREFERRED_PROVIDER_virtual/kernel = "linux-stable"
KBUILD_DEFCONFIG = "x86_64_defconfig"

MACHINE_FEATURES += "x86"

MACHINE_ESSENTIAL_EXTRA_RDEPENDS += "systemd-boot"

MACHINE_ESSENTIAL_EXTRA_RRECOMMENDS += "kernel-module-amdgpu"
```
